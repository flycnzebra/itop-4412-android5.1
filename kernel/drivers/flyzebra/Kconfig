## kernel/drivers/flyzebra/Kconfig
```kconfig
#
# FlyZebra device configuration
#

menu "FlyZebra devices config"

source "drivers/flyzebra/led/Kconfig"
source "drivers/flyzebra/mediatek/Kconfig"
source "drivers/flyzebra/zebra/Kconfig"

endmenu
```

## kernel/drivers/flyzebra/led/Kconfig
```kconfig
config FLYZEBTA_LED_CTL
        bool "flyzebra led config"
        default n
        help
          flyzebra led config
```

## kernel/drivers/flyzebra/zebra/Kconfig
```kconfig
config FLYZEBRA_ZEBRA_CHAR
    bool "flyzebra zebra-char"
	default n
    help
      flyzebra zebra-char driver.
```
